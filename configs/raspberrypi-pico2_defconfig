## configs/raspberrypi-pico2_defconfig
```kconfig
# Architecture
BR2_riscv=y
BR2_riscv_custom=y
BR2_RISCV_ISA_RVM=y
BR2_RISCV_ISA_RVC=y
BR2_RISCV_32=y
# BR2_RISCV_USE_MMU is not set

# System
BR2_GLOBAL_PATCH_DIR="$(BR2_EXTERNAL)/board/raspberrypi/raspberrypi-pico2/patches"
BR2_PTHREADS_NONE=y
BR2_OPTIMIZE_S=y

# Filesystem
BR2_TARGET_ROOTFS_INITRAMFS=y
BR2_ROOTFS_OVERLAY="$(BR2_EXTERNAL)/board/raspberrypi/raspberrypi-pico2/rootfs_overlay"

# Image
BR2_ROOTFS_POST_IMAGE_SCRIPT="support/scripts/genimage.sh"
BR2_ROOTFS_POST_BUILD_SCRIPT="$(BR2_EXTERNAL)/board/raspberrypi/raspberrypi-pico2/post-build.sh"
BR2_ROOTFS_POST_SCRIPT_ARGS="-c $(BR2_EXTERNAL)/board/raspberrypi/raspberrypi-pico2/genimage.cfg"

# Linux headers same as kernel
BR2_PACKAGE_HOST_LINUX_HEADERS_CUSTOM_6_10=y

# Kernel
BR2_LINUX_KERNEL=y
BR2_LINUX_KERNEL_CUSTOM_VERSION=y
BR2_LINUX_KERNEL_CUSTOM_VERSION_VALUE="6.10"
BR2_LINUX_KERNEL_DEFCONFIG="rv32_nommu_virt"
BR2_LINUX_KERNEL_CONFIG_FRAGMENT_FILES="$(BR2_EXTERNAL)/board/raspberrypi/raspberrypi-pico2/raspberrypi-pico2.config"
BR2_LINUX_KERNEL_DTS_SUPPORT=y
BR2_LINUX_KERNEL_CUSTOM_DTS_PATH="$(BR2_EXTERNAL)/board/raspberrypi/raspberrypi-pico2/raspberrypi-pico2.dts"

# Host tools
BR2_PACKAGE_HOST_GENIMAGE=y

# Bruno
BR2_TOOLCHAIN_GCC_OPTIMIZE_SIZE=y
BR2_PACKAGE_BUSYBOX_CONFIG="$(BR2_EXTERNAL)/configs/busybox.config"
CONFIG_SPI=y
CONFIG_SPI_MASTER=y
CONFIG_SPI_SPIDEV=y
#BR2_LUAROCKS_MIRROR="http://rocks.moonscript.org"
#BR2_PACKAGE_LUA=y
#BR2_PACKAGE_PROVIDES_LUAINTERPRETER="lua"
#BR2_PACKAGE_LUA_5_4=y
#BR2_PACKAGE_LUA_32BITS=y
#BR2_PACKAGE_LUA_CVT_N2S=y
#BR2_PACKAGE_LUA_CVT_S2N=y
#BR2_PACKAGE_LUA_READLINE=y
#BR2_PACKAGE_HAS_LUAINTERPRETER=y
#BR2_PACKAGE_LUAINTERPRETER_ABI_VERSION="5.4"
#BR2_PACKAGE_LUAINTERPRETER_ABI_VERSION_5_4=y
#BR2_PACKAGE_PROVIDES_HOST_LUAINTERPRETER="host-lua"
```
